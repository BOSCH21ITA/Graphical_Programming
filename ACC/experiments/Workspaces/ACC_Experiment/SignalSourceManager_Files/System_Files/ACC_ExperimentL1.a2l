ASAP2_VERSION 1 41
/begin PROJECT ACC_Experiment "Generated by ETAS from Project ACC_Experiment"
/begin HEADER "" VERSION "000" PROJECT_NO ASD /end HEADER
/begin MODULE ACC_Experiment "Generated by ETAS ASCET7 from Project: ACC_Experiment"
/begin IF_DATA E_TARGET
 /begin SOURCE "Task0" 3 /* period */ 10 QP_BLOB 1 /end SOURCE
 /begin TP_BLOB /* programm id */ 884013401 /* target id */ 7 0 2 0 /end TP_BLOB
/end IF_DATA
/begin MOD_PAR "" VERSION "000" ADDR_EPK 0x0 EPK "" SUPPLIER "ETAS GmbH" CUSTOMER "xxx" CUSTOMER_NO "000" USER "xxx" PHONE_NO "000" ECU "PC" CPU_TYPE "PCx86" NO_OF_INTERFACES 1 /end MOD_PAR
/begin MOD_COMMON "Common definitions" BYTE_ORDER MSB_LAST ALIGNMENT_BYTE 1 ALIGNMENT_WORD 2 ALIGNMENT_LONG 4 ALIGNMENT_FLOAT32_IEEE 4 ALIGNMENT_FLOAT64_IEEE 8 /end MOD_COMMON
/begin CHARACTERISTIC MyCCF.myCar.myCar.myVehicle.BrakeMomentum "" CURVE 0x0 STANDARD_CURVE_R32R32 0.0 esdl_ident_a -3.4028234663852886E+38 3.4028234663852886E+38
 /begin AXIS_DESCR STD_AXIS NO_INPUT_QUANTITY esdl_ident 6 -3.4028234663852886E+38 3.4028234663852886E+38 /end AXIS_DESCR
/end CHARACTERISTIC
/begin CHARACTERISTIC MyCCF.myCar.myCar.myVehicle.EngineMomentum "" MAP 0x0 STANDARD_MAP_R32R32R32 0.0 esdl_ident_a -3.4028234663852886E+38 3.4028234663852886E+38
 /begin AXIS_DESCR STD_AXIS NO_INPUT_QUANTITY esdl_ident 6 -3.4028234663852886E+38 3.4028234663852886E+38 /end AXIS_DESCR
 /begin AXIS_DESCR STD_AXIS MyCCF.myCar.myCar.myVehicle.v esdl_ident_kmh 6 -3.4028234663852886E+38 3.4028234663852886E+38 /end AXIS_DESCR
/end CHARACTERISTIC
/begin CHARACTERISTIC MyCCF.myCar.myCar.myVehicle.AirFriction "" CURVE 0x0 STANDARD_CURVE_R32R32 0.0 esdl_ident_a -3.4028234663852886E+38 3.4028234663852886E+38
 /begin AXIS_DESCR STD_AXIS MyCCF.myCar.myCar.myVehicle.v esdl_ident_kmh 6 -3.4028234663852886E+38 3.4028234663852886E+38 /end AXIS_DESCR
/end CHARACTERISTIC
/begin CHARACTERISTIC MyCCF.myCar.myCar.myVehicle.Landscape "" CURVE 0x0 STANDARD_CURVE_R32R32 0.0 esdl_ident_m -3.4028234663852886E+38 3.4028234663852886E+38
 /begin AXIS_DESCR STD_AXIS MyCCF.myCar.myCar.myVehicle.dist esdl_ident_m 128 -3.4028234663852886E+38 3.4028234663852886E+38 /end AXIS_DESCR
/end CHARACTERISTIC
/begin MEASUREMENT MyCCF.myCar.myCar.myVehicle.h "" FLOAT32_IEEE esdl_ident_m 1 100.0 -3.4028234663852886E+38 3.4028234663852886E+38 ECU_ADDRESS 0x0 /end MEASUREMENT
/begin MEASUREMENT MyCCF.myCar.myCar.myVehicle.dh "" FLOAT32_IEEE esdl_ident_m 1 100.0 -3.4028234663852886E+38 3.4028234663852886E+38 ECU_ADDRESS 0x0 /end MEASUREMENT
/begin MEASUREMENT MyCCF.myCar.myCar.myVehicle.ds "" FLOAT32_IEEE esdl_ident_m 1 100.0 -3.4028234663852886E+38 3.4028234663852886E+38 ECU_ADDRESS 0x0 /end MEASUREMENT
/begin MEASUREMENT MyCCF.myCar.myCar.myVehicle.momentum "" FLOAT32_IEEE esdl_ident_a 1 100.0 -3.4028234663852886E+38 3.4028234663852886E+38 ECU_ADDRESS 0x0 /end MEASUREMENT
/begin MEASUREMENT MyCCF.myCar.myCar.myVehicle.dist "" FLOAT32_IEEE esdl_ident_m 1 100.0 -3.4028234663852886E+38 3.4028234663852886E+38 ECU_ADDRESS 0x0 /end MEASUREMENT
/begin CHARACTERISTIC MyCCF.myCar.myCar.myVehicle.TrackSize "" VALUE 0x0 STANDARD_VALUE_R32 0.0 esdl_ident_m -3.4028234663852886E+38 3.4028234663852886E+38 /end CHARACTERISTIC
/begin MEASUREMENT MyCCF.myCar.myCar.myVehicle.v "" FLOAT32_IEEE esdl_ident_kmh 1 100.0 -3.4028234663852886E+38 3.4028234663852886E+38 ECU_ADDRESS 0x0 /end MEASUREMENT
/begin MEASUREMENT MyCCF.myCar.myCar.myVehicle.MyTurn_instance.x "" FLOAT32_IEEE esdl_ident_m 1 100.0 -3.4028234663852886E+38 3.4028234663852886E+38 ECU_ADDRESS 0x0 /end MEASUREMENT
/begin MEASUREMENT MyCCF.myCar.myCar.myVehicle.MyTurn_instance.y "" FLOAT32_IEEE esdl_ident_m 1 100.0 -3.4028234663852886E+38 3.4028234663852886E+38 ECU_ADDRESS 0x0 /end MEASUREMENT
/begin MEASUREMENT MyCCF.myCar.myCar.myVehicle.MyTurn_instance.bearing "" FLOAT32_IEEE esdl_ident 1 100.0 -3.4028234663852886E+38 3.4028234663852886E+38 ECU_ADDRESS 0x0 /end MEASUREMENT
/begin CHARACTERISTIC MyCCF.myCar.myCar.myVehicle.MyTurn_instance.D "" VALUE 0x0 STANDARD_VALUE_R32 0.0 esdl_ident_m -3.4028234663852886E+38 3.4028234663852886E+38 /end CHARACTERISTIC
/begin MEASUREMENT MyCCF.myCar.myCar.myVehicle.MyTurn_instance.dpi "" FLOAT32_IEEE esdl_ident 1 100.0 -3.4028234663852886E+38 3.4028234663852886E+38 ECU_ADDRESS 0x0 /end MEASUREMENT
/begin MEASUREMENT MyCCF.myCar.myCar.myVehicle.MyTurn_instance.pi "" FLOAT32_IEEE esdl_ident 1 100.0 -3.4028234663852886E+38 3.4028234663852886E+38 ECU_ADDRESS 0x0 /end MEASUREMENT
/begin MEASUREMENT MyCCF.myCar.myCar.myVehicle.x "" FLOAT32_IEEE esdl_ident_m 1 100.0 -3.4028234663852886E+38 3.4028234663852886E+38 ECU_ADDRESS 0x0 /end MEASUREMENT
/begin MEASUREMENT MyCCF.myCar.myCar.myVehicle.y "" FLOAT32_IEEE esdl_ident_m 1 100.0 -3.4028234663852886E+38 3.4028234663852886E+38 ECU_ADDRESS 0x0 /end MEASUREMENT
/begin MEASUREMENT MyCCF.myCar.myCar.myVehicle.bearing "" FLOAT32_IEEE esdl_ident 1 100.0 -3.4028234663852886E+38 3.4028234663852886E+38 ECU_ADDRESS 0x0 /end MEASUREMENT
/begin CHARACTERISTIC MyCCF.myCar.myCar.g "" VALUE 0x0 STANDARD_VALUE_R32 0.0 esdl_ident_a -3.4028234663852886E+38 3.4028234663852886E+38 /end CHARACTERISTIC
/begin CHARACTERISTIC MyCCF.myCar.myCar.ignition "" VALUE 0x0 STANDARD_VALUE_U8 0.0 esdl_ident 0 1 BIT_MASK 0x1 /end CHARACTERISTIC
/begin CHARACTERISTIC MyCCF.myCar.Driver.controlACC "" VALUE 0x0 STANDARD_VALUE_U8 0.0 esdl_ident 0 1 BIT_MASK 0x1 /end CHARACTERISTIC
/begin CHARACTERISTIC MyCCF.myCar.Driver.brake "" VALUE 0x0 STANDARD_VALUE_R32 0.0 esdl_ident -3.4028234663852886E+38 3.4028234663852886E+38 /end CHARACTERISTIC
/begin CHARACTERISTIC MyCCF.myCar.Driver.ignition "" VALUE 0x0 STANDARD_VALUE_U8 0.0 esdl_ident 0 1 BIT_MASK 0x1 /end CHARACTERISTIC
/begin CHARACTERISTIC MyCCF.myCar.Driver.power "" VALUE 0x0 STANDARD_VALUE_R32 0.0 esdl_ident -3.4028234663852886E+38 3.4028234663852886E+38 /end CHARACTERISTIC
/begin CHARACTERISTIC MyCCF.myCar.Driver.targetSpeed "" VALUE 0x0 STANDARD_VALUE_R32 0.0 esdl_ident_kmh -3.4028234663852886E+38 3.4028234663852886E+38 /end CHARACTERISTIC
/begin MEASUREMENT MyCCF.myCar.Control.ACC_instance.sm "" UBYTE esdl_MyCCF_myCar_ACCStatemachineStates 1 100.0 0 2 ECU_ADDRESS 0x0 /end MEASUREMENT
/begin MEASUREMENT MyCCF.myCar.Control.ACC_instance.brake "" FLOAT32_IEEE esdl_ident 1 100.0 -3.4028234663852886E+38 3.4028234663852886E+38 ECU_ADDRESS 0x0 /end MEASUREMENT
/begin MEASUREMENT MyCCF.myCar.Control.ACC_instance.on "" UBYTE esdl_ident 1 100.0 0 1 ECU_ADDRESS 0x0 BIT_MASK 0x1 /end MEASUREMENT
/begin MEASUREMENT MyCCF.myCar.Control.ACC_instance.accOn "" UBYTE esdl_ident 1 100.0 0 1 ECU_ADDRESS 0x0 BIT_MASK 0x1 /end MEASUREMENT
/begin MEASUREMENT MyCCF.myCar.Control.EdgeRising_instance.buffer "" UBYTE esdl_ident 1 100.0 0 1 ECU_ADDRESS 0x0 BIT_MASK 0x1 /end MEASUREMENT
/begin MEASUREMENT MyCCF.myCar.Control.EdgeRising_instance.oldSignal "" UBYTE esdl_ident 1 100.0 0 1 ECU_ADDRESS 0x0 BIT_MASK 0x1 /end MEASUREMENT
/begin CHARACTERISTIC MyCCF.myCar.Control.Regler_instance.p "" VALUE 0x0 STANDARD_VALUE_R32 0.0 esdl_ident -3.4028234663852886E+38 3.4028234663852886E+38 /end CHARACTERISTIC
/begin MEASUREMENT MyCCF.myCar.Control.Regler_instance.pow "" FLOAT32_IEEE esdl_ident 1 100.0 -3.4028234663852886E+38 3.4028234663852886E+38 ECU_ADDRESS 0x0 /end MEASUREMENT
/begin MEASUREMENT MyCCF.myCar.Control.Regler_instance.bra "" FLOAT32_IEEE esdl_ident 1 100.0 -3.4028234663852886E+38 3.4028234663852886E+38 ECU_ADDRESS 0x0 /end MEASUREMENT
/begin CHARACTERISTIC MyCCF.myCar.Control.Regler_instance_2.p "" VALUE 0x0 STANDARD_VALUE_R32 0.0 esdl_ident -3.4028234663852886E+38 3.4028234663852886E+38 /end CHARACTERISTIC
/begin MEASUREMENT MyCCF.myCar.Control.Regler_instance_2.pow "" FLOAT32_IEEE esdl_ident 1 100.0 -3.4028234663852886E+38 3.4028234663852886E+38 ECU_ADDRESS 0x0 /end MEASUREMENT
/begin MEASUREMENT MyCCF.myCar.Control.Regler_instance_2.bra "" FLOAT32_IEEE esdl_ident 1 100.0 -3.4028234663852886E+38 3.4028234663852886E+38 ECU_ADDRESS 0x0 /end MEASUREMENT
/begin MEASUREMENT MyCCF.resources.CarMessages.v "" FLOAT32_IEEE esdl_ident_km2fh 1 100.0 0.0 200.0 ECU_ADDRESS 0x0 /end MEASUREMENT
/begin MEASUREMENT MyCCF.resources.CarMessages.power "" FLOAT32_IEEE esdl_ident 1 100.0 -3.4028234663852886E+38 3.4028234663852886E+38 ECU_ADDRESS 0x0 /end MEASUREMENT
/begin MEASUREMENT MyCCF.resources.CarMessages.brake "" FLOAT32_IEEE esdl_ident 1 100.0 -3.4028234663852886E+38 3.4028234663852886E+38 ECU_ADDRESS 0x0 /end MEASUREMENT
/begin MEASUREMENT MyCCF.resources.CarMessages.steering "" FLOAT32_IEEE esdl_ident 1 100.0 -3.4028234663852886E+38 3.4028234663852886E+38 ECU_ADDRESS 0x0 /end MEASUREMENT
/begin MEASUREMENT MyCCF.resources.CarMessages.bearing "" FLOAT32_IEEE esdl_ident 1 100.0 -3.4028234663852886E+38 3.4028234663852886E+38 ECU_ADDRESS 0x0 /end MEASUREMENT
/begin MEASUREMENT MyCCF.resources.CarMessages.x "" FLOAT32_IEEE esdl_ident_m 1 100.0 -3.4028234663852886E+38 3.4028234663852886E+38 ECU_ADDRESS 0x0 /end MEASUREMENT
/begin MEASUREMENT MyCCF.resources.CarMessages.y "" FLOAT32_IEEE esdl_ident_m 1 100.0 -3.4028234663852886E+38 3.4028234663852886E+38 ECU_ADDRESS 0x0 /end MEASUREMENT
/begin MEASUREMENT MyCCF.resources.CarMessages.time "" FLOAT32_IEEE esdl_ident_s 1 100.0 -3.4028234663852886E+38 3.4028234663852886E+38 ECU_ADDRESS 0x0 /end MEASUREMENT
/begin MEASUREMENT MyCCF.resources.DriverMessages.brake "" FLOAT32_IEEE esdl_ident 1 100.0 -3.4028234663852886E+38 3.4028234663852886E+38 ECU_ADDRESS 0x0 /end MEASUREMENT
/begin MEASUREMENT MyCCF.resources.DriverMessages.power "" FLOAT32_IEEE esdl_ident 1 100.0 -3.4028234663852886E+38 3.4028234663852886E+38 ECU_ADDRESS 0x0 /end MEASUREMENT
/begin MEASUREMENT MyCCF.resources.DriverMessages.ignition "" UBYTE esdl_ident 1 100.0 0 1 ECU_ADDRESS 0x0 BIT_MASK 0x1 /end MEASUREMENT
/begin MEASUREMENT MyCCF.resources.DriverMessages.on "" UBYTE esdl_ident 1 100.0 0 1 ECU_ADDRESS 0x0 BIT_MASK 0x1 /end MEASUREMENT
/begin MEASUREMENT MyCCF.resources.DriverMessages.display "" UBYTE esdl_ident 1 100.0 0 1 ECU_ADDRESS 0x0 BIT_MASK 0x1 /end MEASUREMENT
/begin MEASUREMENT MyCCF.resources.DriverMessages.increment "" UBYTE esdl_ident 1 100.0 0 1 ECU_ADDRESS 0x0 BIT_MASK 0x1 /end MEASUREMENT
/begin MEASUREMENT MyCCF.resources.DriverMessages.decrement "" UBYTE esdl_ident 1 100.0 0 1 ECU_ADDRESS 0x0 BIT_MASK 0x1 /end MEASUREMENT
/begin MEASUREMENT MyCCF.resources.DriverMessages.soll "" FLOAT32_IEEE esdl_ident_kmh 1 100.0 -3.4028234663852886E+38 3.4028234663852886E+38 ECU_ADDRESS 0x0 /end MEASUREMENT
/begin COMPU_METHOD esdl_MyCCF_myCar_ACCStatemachineStates "" TAB_VERB "%12.4" "" /* compu_tab_ref */ COMPU_TAB_REF esdl_MyCCF_myCar_ACCStatemachineStates_vtab /end COMPU_METHOD
/begin COMPU_VTAB esdl_MyCCF_myCar_ACCStatemachineStates_vtab "" TAB_VERB /* number value pairs */ 3 2 "On" 0 "Off" 1 "Braking" /* default value */ DEFAULT_VALUE "Error" /end COMPU_VTAB
/begin COMPU_METHOD esdl_ident "" RAT_FUNC "%12.4" "" COEFFS 0 1 0 0 0 1 /end COMPU_METHOD
/begin COMPU_METHOD esdl_ident_a "" RAT_FUNC "%12.4" "a" COEFFS 0 1 0 0 0 1 /end COMPU_METHOD
/begin COMPU_METHOD esdl_ident_km2fh "" RAT_FUNC "%12.4" "km/h" COEFFS 0 1 0 0 0 1 /end COMPU_METHOD
/begin COMPU_METHOD esdl_ident_kmh "" RAT_FUNC "%12.4" "kmh" COEFFS 0 1 0 0 0 1 /end COMPU_METHOD
/begin COMPU_METHOD esdl_ident_m "" RAT_FUNC "%12.4" "m" COEFFS 0 1 0 0 0 1 /end COMPU_METHOD
/begin COMPU_METHOD esdl_ident_s "" RAT_FUNC "%12.4" "s" COEFFS 0 1 0 0 0 1 /end COMPU_METHOD
/begin FUNCTION MyCCF.myCar.myCar "" /begin DEF_CHARACTERISTIC MyCCF.myCar.myCar.g MyCCF.myCar.myCar.ignition /end DEF_CHARACTERISTIC
 /begin IN_MEASUREMENT MyCCF.resources.CarMessages.brake MyCCF.resources.CarMessages.power MyCCF.resources.CarMessages.steering MyCCF.resources.DriverMessages.ignition /end IN_MEASUREMENT
 /begin OUT_MEASUREMENT MyCCF.resources.CarMessages.bearing MyCCF.resources.CarMessages.v MyCCF.resources.CarMessages.x MyCCF.resources.CarMessages.y /end OUT_MEASUREMENT
 /begin SUB_FUNCTION MyCCF.myCar.myCar.myVehicle /end SUB_FUNCTION
/end FUNCTION
/begin FUNCTION MyCCF.myCar.myCar.myVehicle ""
 /begin DEF_CHARACTERISTIC MyCCF.myCar.myCar.myVehicle.BrakeMomentum MyCCF.myCar.myCar.myVehicle.EngineMomentum MyCCF.myCar.myCar.myVehicle.AirFriction MyCCF.myCar.myCar.myVehicle.Landscape MyCCF.myCar.myCar.myVehicle.TrackSize /end DEF_CHARACTERISTIC
 /begin LOC_MEASUREMENT MyCCF.myCar.myCar.myVehicle.bearing MyCCF.myCar.myCar.myVehicle.dh MyCCF.myCar.myCar.myVehicle.dist MyCCF.myCar.myCar.myVehicle.ds MyCCF.myCar.myCar.myVehicle.h MyCCF.myCar.myCar.myVehicle.momentum MyCCF.myCar.myCar.myVehicle.v MyCCF.myCar.myCar.myVehicle.x MyCCF.myCar.myCar.myVehicle.y /end LOC_MEASUREMENT
 /begin SUB_FUNCTION MyCCF.myCar.myCar.myVehicle.MyTurn_instance /end SUB_FUNCTION
/end FUNCTION
/begin FUNCTION MyCCF.myCar.myCar.myVehicle.MyTurn_instance "" /begin DEF_CHARACTERISTIC MyCCF.myCar.myCar.myVehicle.MyTurn_instance.D /end DEF_CHARACTERISTIC
 /begin LOC_MEASUREMENT MyCCF.myCar.myCar.myVehicle.MyTurn_instance.bearing MyCCF.myCar.myCar.myVehicle.MyTurn_instance.dpi MyCCF.myCar.myCar.myVehicle.MyTurn_instance.pi MyCCF.myCar.myCar.myVehicle.MyTurn_instance.x MyCCF.myCar.myCar.myVehicle.MyTurn_instance.y /end LOC_MEASUREMENT
/end FUNCTION
/begin FUNCTION MyCCF.myCar.Driver ""
 /begin DEF_CHARACTERISTIC MyCCF.myCar.Driver.controlACC MyCCF.myCar.Driver.brake MyCCF.myCar.Driver.ignition MyCCF.myCar.Driver.power MyCCF.myCar.Driver.targetSpeed /end DEF_CHARACTERISTIC
 /begin IN_MEASUREMENT MyCCF.resources.DriverMessages.display /end IN_MEASUREMENT
 /begin OUT_MEASUREMENT MyCCF.resources.DriverMessages.brake MyCCF.resources.DriverMessages.ignition MyCCF.resources.DriverMessages.on MyCCF.resources.DriverMessages.power MyCCF.resources.DriverMessages.soll /end OUT_MEASUREMENT
/end FUNCTION
/begin FUNCTION MyCCF.myCar.Control ""
 /begin IN_MEASUREMENT MyCCF.resources.CarMessages.v MyCCF.resources.DriverMessages.brake MyCCF.resources.DriverMessages.on MyCCF.resources.DriverMessages.power MyCCF.resources.DriverMessages.soll /end IN_MEASUREMENT
 /begin OUT_MEASUREMENT MyCCF.resources.CarMessages.brake MyCCF.resources.CarMessages.power MyCCF.resources.DriverMessages.display /end OUT_MEASUREMENT
 /begin SUB_FUNCTION MyCCF.myCar.Control.ACC_instance MyCCF.myCar.Control.EdgeRising_instance MyCCF.myCar.Control.Regler_instance MyCCF.myCar.Control.Regler_instance_2 /end SUB_FUNCTION
/end FUNCTION
/begin FUNCTION MyCCF.myCar.Control.ACC_instance ""
 /begin LOC_MEASUREMENT MyCCF.myCar.Control.ACC_instance.accOn MyCCF.myCar.Control.ACC_instance.brake MyCCF.myCar.Control.ACC_instance.on MyCCF.myCar.Control.ACC_instance.sm /end LOC_MEASUREMENT
/end FUNCTION
/begin FUNCTION MyCCF.myCar.Control.EdgeRising_instance "EdgeRising detects a rising edge of the logical input signal."
 /begin LOC_MEASUREMENT MyCCF.myCar.Control.EdgeRising_instance.buffer MyCCF.myCar.Control.EdgeRising_instance.oldSignal /end LOC_MEASUREMENT
/end FUNCTION
/begin FUNCTION MyCCF.myCar.Control.Regler_instance "" /begin DEF_CHARACTERISTIC MyCCF.myCar.Control.Regler_instance.p /end DEF_CHARACTERISTIC
 /begin LOC_MEASUREMENT MyCCF.myCar.Control.Regler_instance.bra MyCCF.myCar.Control.Regler_instance.pow /end LOC_MEASUREMENT
/end FUNCTION
/begin FUNCTION MyCCF.myCar.Control.Regler_instance_2 "" /begin DEF_CHARACTERISTIC MyCCF.myCar.Control.Regler_instance_2.p /end DEF_CHARACTERISTIC
 /begin LOC_MEASUREMENT MyCCF.myCar.Control.Regler_instance_2.bra MyCCF.myCar.Control.Regler_instance_2.pow /end LOC_MEASUREMENT
/end FUNCTION
/begin RECORD_LAYOUT STANDARD_CURVE_R32R32 /* axis size */ NO_AXIS_PTS_X 1 UWORD /* axis */ AXIS_PTS_X 2 FLOAT32_IEEE INDEX_INCR DIRECT FNC_VALUES 3 FLOAT32_IEEE COLUMN_DIR DIRECT /end RECORD_LAYOUT
/begin RECORD_LAYOUT STANDARD_MAP_R32R32R32 /* x axis size */ NO_AXIS_PTS_X 1 UWORD /* y axis size */ NO_AXIS_PTS_Y 2 UWORD /* x axis */ AXIS_PTS_X 3 FLOAT32_IEEE INDEX_INCR DIRECT /* y axis */ AXIS_PTS_Y 4 FLOAT32_IEEE INDEX_INCR DIRECT FNC_VALUES 5 FLOAT32_IEEE COLUMN_DIR DIRECT /end RECORD_LAYOUT
/begin RECORD_LAYOUT STANDARD_VALUE_R32 FNC_VALUES 1 FLOAT32_IEEE COLUMN_DIR DIRECT /end RECORD_LAYOUT
/begin RECORD_LAYOUT STANDARD_VALUE_U8 FNC_VALUES 1 UBYTE COLUMN_DIR DIRECT /end RECORD_LAYOUT
/begin GROUP MyCCF.myCar.Control "" ROOT
 /begin SUB_GROUP MyCCF.myCar.Control.ACC_instance MyCCF.myCar.Control.EdgeRising_instance MyCCF.myCar.Control.Regler_instance MyCCF.myCar.Control.Regler_instance_2 /end SUB_GROUP
/end GROUP
/begin GROUP MyCCF.myCar.Control.ACC_instance ""
 /begin REF_MEASUREMENT MyCCF.myCar.Control.ACC_instance.accOn MyCCF.myCar.Control.ACC_instance.brake MyCCF.myCar.Control.ACC_instance.on MyCCF.myCar.Control.ACC_instance.sm /end REF_MEASUREMENT
/end GROUP
/begin GROUP MyCCF.myCar.Control.EdgeRising_instance "EdgeRising detects a rising edge of the logical input signal."
 /begin REF_MEASUREMENT MyCCF.myCar.Control.EdgeRising_instance.buffer MyCCF.myCar.Control.EdgeRising_instance.oldSignal /end REF_MEASUREMENT
/end GROUP
/begin GROUP MyCCF.myCar.Control.Regler_instance "" /begin REF_CHARACTERISTIC MyCCF.myCar.Control.Regler_instance.p /end REF_CHARACTERISTIC
 /begin REF_MEASUREMENT MyCCF.myCar.Control.Regler_instance.bra MyCCF.myCar.Control.Regler_instance.pow /end REF_MEASUREMENT
/end GROUP
/begin GROUP MyCCF.myCar.Control.Regler_instance_2 "" /begin REF_CHARACTERISTIC MyCCF.myCar.Control.Regler_instance_2.p /end REF_CHARACTERISTIC
 /begin REF_MEASUREMENT MyCCF.myCar.Control.Regler_instance_2.bra MyCCF.myCar.Control.Regler_instance_2.pow /end REF_MEASUREMENT
/end GROUP
/begin GROUP MyCCF.myCar.Driver "" ROOT
 /begin REF_CHARACTERISTIC MyCCF.myCar.Driver.controlACC MyCCF.myCar.Driver.brake MyCCF.myCar.Driver.ignition MyCCF.myCar.Driver.power MyCCF.myCar.Driver.targetSpeed /end REF_CHARACTERISTIC
/end GROUP
/begin GROUP MyCCF.myCar.myCar "" ROOT /begin REF_CHARACTERISTIC MyCCF.myCar.myCar.g MyCCF.myCar.myCar.ignition /end REF_CHARACTERISTIC /begin SUB_GROUP MyCCF.myCar.myCar.myVehicle /end SUB_GROUP /end GROUP
/begin GROUP MyCCF.myCar.myCar.myVehicle ""
 /begin REF_CHARACTERISTIC MyCCF.myCar.myCar.myVehicle.BrakeMomentum MyCCF.myCar.myCar.myVehicle.EngineMomentum MyCCF.myCar.myCar.myVehicle.AirFriction MyCCF.myCar.myCar.myVehicle.Landscape MyCCF.myCar.myCar.myVehicle.TrackSize /end REF_CHARACTERISTIC
 /begin REF_MEASUREMENT MyCCF.myCar.myCar.myVehicle.bearing MyCCF.myCar.myCar.myVehicle.dh MyCCF.myCar.myCar.myVehicle.dist MyCCF.myCar.myCar.myVehicle.ds MyCCF.myCar.myCar.myVehicle.h MyCCF.myCar.myCar.myVehicle.momentum MyCCF.myCar.myCar.myVehicle.v MyCCF.myCar.myCar.myVehicle.x MyCCF.myCar.myCar.myVehicle.y /end REF_MEASUREMENT
 /begin SUB_GROUP MyCCF.myCar.myCar.myVehicle.MyTurn_instance /end SUB_GROUP
/end GROUP
/begin GROUP MyCCF.myCar.myCar.myVehicle.MyTurn_instance "" /begin REF_CHARACTERISTIC MyCCF.myCar.myCar.myVehicle.MyTurn_instance.D /end REF_CHARACTERISTIC
 /begin REF_MEASUREMENT MyCCF.myCar.myCar.myVehicle.MyTurn_instance.bearing MyCCF.myCar.myCar.myVehicle.MyTurn_instance.dpi MyCCF.myCar.myCar.myVehicle.MyTurn_instance.pi MyCCF.myCar.myCar.myVehicle.MyTurn_instance.x MyCCF.myCar.myCar.myVehicle.MyTurn_instance.y /end REF_MEASUREMENT
/end GROUP
/begin GROUP MyCCF.resources.CarMessages "" ROOT
 /begin REF_MEASUREMENT MyCCF.resources.CarMessages.bearing MyCCF.resources.CarMessages.brake MyCCF.resources.CarMessages.power MyCCF.resources.CarMessages.steering MyCCF.resources.CarMessages.time MyCCF.resources.CarMessages.v MyCCF.resources.CarMessages.x MyCCF.resources.CarMessages.y /end REF_MEASUREMENT
/end GROUP
/begin GROUP MyCCF.resources.DriverMessages "" ROOT
 /begin REF_MEASUREMENT MyCCF.resources.DriverMessages.brake MyCCF.resources.DriverMessages.decrement MyCCF.resources.DriverMessages.display MyCCF.resources.DriverMessages.ignition MyCCF.resources.DriverMessages.increment MyCCF.resources.DriverMessages.on MyCCF.resources.DriverMessages.power MyCCF.resources.DriverMessages.soll /end REF_MEASUREMENT
/end GROUP
/end MODULE
/end PROJECT
