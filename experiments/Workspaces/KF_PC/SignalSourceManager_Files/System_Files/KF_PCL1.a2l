ASAP2_VERSION 1 41
/begin PROJECT KF_PC "Generated by ETAS from Project KF_PC"
/begin HEADER "" VERSION "000" PROJECT_NO ASD /end HEADER
/begin MODULE KF_PC "Generated by ETAS ASCET7 from Project: KF_PC"
/begin IF_DATA E_TARGET
 /begin SOURCE "Task0" 3 /* period */ 10 QP_BLOB 1 /end SOURCE
 /begin TP_BLOB /* programm id */ 882787741 /* target id */ 7 0 2 0 /end TP_BLOB
/end IF_DATA
/begin MOD_PAR "" VERSION "000" ADDR_EPK 0x0 EPK "" SUPPLIER "ETAS GmbH" CUSTOMER "xxx" CUSTOMER_NO "000" USER "xxx" PHONE_NO "000" ECU "PC" CPU_TYPE "PCx86" NO_OF_INTERFACES 1 /end MOD_PAR
/begin MOD_COMMON "Common definitions" BYTE_ORDER MSB_LAST ALIGNMENT_BYTE 1 ALIGNMENT_WORD 2 ALIGNMENT_LONG 4 ALIGNMENT_FLOAT32_IEEE 4 ALIGNMENT_FLOAT64_IEEE 8 /end MOD_COMMON
/begin CHARACTERISTIC myCar.myCar.myVehicle.BrakeMomentum "" CURVE 0x0 STANDARD_CURVE_R32R32 0.0 esdl_ident_a -3.4028234663852886E+38 3.4028234663852886E+38
 /begin AXIS_DESCR STD_AXIS NO_INPUT_QUANTITY esdl_ident 6 -3.4028234663852886E+38 3.4028234663852886E+38 /end AXIS_DESCR
/end CHARACTERISTIC
/begin CHARACTERISTIC myCar.myCar.myVehicle.EngineMomentum "" MAP 0x0 STANDARD_MAP_R32R32R32 0.0 esdl_ident_a -3.4028234663852886E+38 3.4028234663852886E+38
 /begin AXIS_DESCR STD_AXIS NO_INPUT_QUANTITY esdl_ident 6 -3.4028234663852886E+38 3.4028234663852886E+38 /end AXIS_DESCR
 /begin AXIS_DESCR STD_AXIS myCar.myCar.myVehicle.v esdl_ident_kmh 6 -3.4028234663852886E+38 3.4028234663852886E+38 /end AXIS_DESCR
/end CHARACTERISTIC
/begin CHARACTERISTIC myCar.myCar.myVehicle.AirFriction "" CURVE 0x0 STANDARD_CURVE_R32R32 0.0 esdl_ident_a -3.4028234663852886E+38 3.4028234663852886E+38
 /begin AXIS_DESCR STD_AXIS myCar.myCar.myVehicle.v esdl_ident_kmh 6 -3.4028234663852886E+38 3.4028234663852886E+38 /end AXIS_DESCR
/end CHARACTERISTIC
/begin CHARACTERISTIC myCar.myCar.myVehicle.Landscape "" CURVE 0x0 STANDARD_CURVE_R32R32 0.0 esdl_ident_m -3.4028234663852886E+38 3.4028234663852886E+38
 /begin AXIS_DESCR STD_AXIS myCar.myCar.myVehicle.dist esdl_ident_m 128 -3.4028234663852886E+38 3.4028234663852886E+38 /end AXIS_DESCR
/end CHARACTERISTIC
/begin MEASUREMENT myCar.myCar.myVehicle.h "" FLOAT32_IEEE esdl_ident_m 1 100.0 -3.4028234663852886E+38 3.4028234663852886E+38 ECU_ADDRESS 0x0 /end MEASUREMENT
/begin MEASUREMENT myCar.myCar.myVehicle.dh "" FLOAT32_IEEE esdl_ident_m 1 100.0 -3.4028234663852886E+38 3.4028234663852886E+38 ECU_ADDRESS 0x0 /end MEASUREMENT
/begin MEASUREMENT myCar.myCar.myVehicle.ds "" FLOAT32_IEEE esdl_ident_m 1 100.0 -3.4028234663852886E+38 3.4028234663852886E+38 ECU_ADDRESS 0x0 /end MEASUREMENT
/begin MEASUREMENT myCar.myCar.myVehicle.momentum "" FLOAT32_IEEE esdl_ident_a 1 100.0 -3.4028234663852886E+38 3.4028234663852886E+38 ECU_ADDRESS 0x0 /end MEASUREMENT
/begin MEASUREMENT myCar.myCar.myVehicle.dist "" FLOAT32_IEEE esdl_ident_m 1 100.0 -3.4028234663852886E+38 3.4028234663852886E+38 ECU_ADDRESS 0x0 /end MEASUREMENT
/begin CHARACTERISTIC myCar.myCar.myVehicle.TrackSize "" VALUE 0x0 STANDARD_VALUE_R32 0.0 esdl_ident_m -3.4028234663852886E+38 3.4028234663852886E+38 /end CHARACTERISTIC
/begin MEASUREMENT myCar.myCar.myVehicle.v "" FLOAT32_IEEE esdl_ident_kmh 1 100.0 -3.4028234663852886E+38 3.4028234663852886E+38 ECU_ADDRESS 0x0 /end MEASUREMENT
/begin MEASUREMENT myCar.myCar.myVehicle.MyTurn_instance.x "" FLOAT32_IEEE esdl_ident_m 1 100.0 -3.4028234663852886E+38 3.4028234663852886E+38 ECU_ADDRESS 0x0 /end MEASUREMENT
/begin MEASUREMENT myCar.myCar.myVehicle.MyTurn_instance.y "" FLOAT32_IEEE esdl_ident_m 1 100.0 -3.4028234663852886E+38 3.4028234663852886E+38 ECU_ADDRESS 0x0 /end MEASUREMENT
/begin MEASUREMENT myCar.myCar.myVehicle.MyTurn_instance.bearing "" FLOAT32_IEEE esdl_ident 1 100.0 -3.4028234663852886E+38 3.4028234663852886E+38 ECU_ADDRESS 0x0 /end MEASUREMENT
/begin CHARACTERISTIC myCar.myCar.myVehicle.MyTurn_instance.D "" VALUE 0x0 STANDARD_VALUE_R32 0.0 esdl_ident_m -3.4028234663852886E+38 3.4028234663852886E+38 /end CHARACTERISTIC
/begin MEASUREMENT myCar.myCar.myVehicle.MyTurn_instance.dpi "" FLOAT32_IEEE esdl_ident 1 100.0 -3.4028234663852886E+38 3.4028234663852886E+38 ECU_ADDRESS 0x0 /end MEASUREMENT
/begin MEASUREMENT myCar.myCar.myVehicle.MyTurn_instance.pi "" FLOAT32_IEEE esdl_ident 1 100.0 -3.4028234663852886E+38 3.4028234663852886E+38 ECU_ADDRESS 0x0 /end MEASUREMENT
/begin MEASUREMENT myCar.myCar.myVehicle.x "" FLOAT32_IEEE esdl_ident_m 1 100.0 -3.4028234663852886E+38 3.4028234663852886E+38 ECU_ADDRESS 0x0 /end MEASUREMENT
/begin MEASUREMENT myCar.myCar.myVehicle.y "" FLOAT32_IEEE esdl_ident_m 1 100.0 -3.4028234663852886E+38 3.4028234663852886E+38 ECU_ADDRESS 0x0 /end MEASUREMENT
/begin MEASUREMENT myCar.myCar.myVehicle.bearing "" FLOAT32_IEEE esdl_ident 1 100.0 -3.4028234663852886E+38 3.4028234663852886E+38 ECU_ADDRESS 0x0 /end MEASUREMENT
/begin CHARACTERISTIC myCar.myCar.g "" VALUE 0x0 STANDARD_VALUE_R32 0.0 esdl_ident_a -3.4028234663852886E+38 3.4028234663852886E+38 /end CHARACTERISTIC
/begin MEASUREMENT myCar.Control.Regler_instance.pow "" FLOAT32_IEEE esdl_ident 1 100.0 -3.4028234663852886E+38 3.4028234663852886E+38 ECU_ADDRESS 0x0 /end MEASUREMENT
/begin MEASUREMENT myCar.Control.Regler_instance.bra "" FLOAT32_IEEE esdl_ident 1 100.0 -3.4028234663852886E+38 3.4028234663852886E+38 ECU_ADDRESS 0x0 /end MEASUREMENT
/begin MEASUREMENT myCar.Control.CSM_instance.sm "" UBYTE esdl_myCar_CSMStatemachineStates 1 100.0 0 1 ECU_ADDRESS 0x0 /end MEASUREMENT
/begin MEASUREMENT myCar.Control.CSM_instance.bra "" FLOAT32_IEEE esdl_ident 1 100.0 -3.4028234663852886E+38 3.4028234663852886E+38 ECU_ADDRESS 0x0 /end MEASUREMENT
/begin MEASUREMENT myCar.Control.CSM_instance.on "" UBYTE esdl_ident 1 100.0 0 1 ECU_ADDRESS 0x0 BIT_MASK 0x1 /end MEASUREMENT
/begin MEASUREMENT myCar.Control.CSM_instance.isOn "" UBYTE esdl_ident 1 100.0 0 1 ECU_ADDRESS 0x0 BIT_MASK 0x1 /end MEASUREMENT
/begin CHARACTERISTIC myCar.Driver.mypower "" VALUE 0x0 STANDARD_VALUE_R32 0.0 esdl_ident -3.4028234663852886E+38 3.4028234663852886E+38 /end CHARACTERISTIC
/begin CHARACTERISTIC myCar.Driver.mysoll "" VALUE 0x0 STANDARD_VALUE_R32 0.0 esdl_ident_kmh -3.4028234663852886E+38 3.4028234663852886E+38 /end CHARACTERISTIC
/begin CHARACTERISTIC myCar.Driver.myon "" VALUE 0x0 STANDARD_VALUE_U8 0.0 esdl_ident 0 1 BIT_MASK 0x1 /end CHARACTERISTIC
/begin CHARACTERISTIC myCar.Driver.automatic "" VALUE 0x0 STANDARD_VALUE_U8 0.0 esdl_ident 0 1 BIT_MASK 0x1 /end CHARACTERISTIC
/begin MEASUREMENT myCar.Driver.EdgeRising_instance.buffer "" UBYTE esdl_ident 1 100.0 0 1 ECU_ADDRESS 0x0 BIT_MASK 0x1 /end MEASUREMENT
/begin MEASUREMENT myCar.Driver.EdgeRising_instance.oldSignal "" UBYTE esdl_ident 1 100.0 0 1 ECU_ADDRESS 0x0 BIT_MASK 0x1 /end MEASUREMENT
/begin MEASUREMENT myCar.Driver.StopWatch_instance.timeCounter "" FLOAT32_IEEE esdl_ident 1 100.0 -3.4028234663852886E+38 3.4028234663852886E+38 ECU_ADDRESS 0x0 /end MEASUREMENT
/begin MEASUREMENT myCar.Driver.R.buffer "" UBYTE esdl_ident 1 100.0 0 1 ECU_ADDRESS 0x0 BIT_MASK 0x1 /end MEASUREMENT
/begin MEASUREMENT myCar.Driver.R.oldSignal "" UBYTE esdl_ident 1 100.0 0 1 ECU_ADDRESS 0x0 BIT_MASK 0x1 /end MEASUREMENT
/begin CHARACTERISTIC myCar.KFDriver.power "" CURVE 0x0 STANDARD_CURVE_R32R32 0.0 esdl_ident -3.4028234663852886E+38 3.4028234663852886E+38
 /begin AXIS_DESCR STD_AXIS NO_INPUT_QUANTITY esdl_ident 12 -3.4028234663852886E+38 3.4028234663852886E+38 /end AXIS_DESCR
/end CHARACTERISTIC
/begin MEASUREMENT myCar.KFDriver.SW.timeCounter "" FLOAT32_IEEE esdl_ident 1 100.0 -3.4028234663852886E+38 3.4028234663852886E+38 ECU_ADDRESS 0x0 /end MEASUREMENT
/begin CHARACTERISTIC myCar.KFDriver.duration "" VALUE 0x0 STANDARD_VALUE_R32 0.0 esdl_ident -3.4028234663852886E+38 3.4028234663852886E+38 /end CHARACTERISTIC
/begin CHARACTERISTIC myCar.KFDriver.on "" CURVE 0x0 STANDARD_CURVE_R32R32 0.0 esdl_ident -3.4028234663852886E+38 3.4028234663852886E+38
 /begin AXIS_DESCR STD_AXIS NO_INPUT_QUANTITY esdl_ident 12 -3.4028234663852886E+38 3.4028234663852886E+38 /end AXIS_DESCR
/end CHARACTERISTIC
/begin CHARACTERISTIC myCar.KFDriver.brake "" CURVE 0x0 STANDARD_CURVE_R32R32 0.0 esdl_ident -3.4028234663852886E+38 3.4028234663852886E+38
 /begin AXIS_DESCR STD_AXIS NO_INPUT_QUANTITY esdl_ident 12 -3.4028234663852886E+38 3.4028234663852886E+38 /end AXIS_DESCR
/end CHARACTERISTIC
/begin CHARACTERISTIC myCar.KFDriver.soll "" CURVE 0x0 STANDARD_CURVE_R32R32 0.0 esdl_ident -3.4028234663852886E+38 3.4028234663852886E+38
 /begin AXIS_DESCR STD_AXIS NO_INPUT_QUANTITY esdl_ident 3 -3.4028234663852886E+38 3.4028234663852886E+38 /end AXIS_DESCR
/end CHARACTERISTIC
/begin MEASUREMENT resources.CarMessages.v "" FLOAT32_IEEE esdl_ident_km2fh 1 100.0 0.0 200.0 ECU_ADDRESS 0x0 /end MEASUREMENT
/begin MEASUREMENT resources.CarMessages.power "" FLOAT32_IEEE esdl_ident 1 100.0 -3.4028234663852886E+38 3.4028234663852886E+38 ECU_ADDRESS 0x0 /end MEASUREMENT
/begin MEASUREMENT resources.CarMessages.brake "" FLOAT32_IEEE esdl_ident 1 100.0 -3.4028234663852886E+38 3.4028234663852886E+38 ECU_ADDRESS 0x0 /end MEASUREMENT
/begin MEASUREMENT resources.CarMessages.steering "" FLOAT32_IEEE esdl_ident 1 100.0 -3.4028234663852886E+38 3.4028234663852886E+38 ECU_ADDRESS 0x0 /end MEASUREMENT
/begin MEASUREMENT resources.CarMessages.bearing "" FLOAT32_IEEE esdl_ident 1 100.0 -3.4028234663852886E+38 3.4028234663852886E+38 ECU_ADDRESS 0x0 /end MEASUREMENT
/begin MEASUREMENT resources.CarMessages.x "" FLOAT32_IEEE esdl_ident_m 1 100.0 -3.4028234663852886E+38 3.4028234663852886E+38 ECU_ADDRESS 0x0 /end MEASUREMENT
/begin MEASUREMENT resources.CarMessages.y "" FLOAT32_IEEE esdl_ident_m 1 100.0 -3.4028234663852886E+38 3.4028234663852886E+38 ECU_ADDRESS 0x0 /end MEASUREMENT
/begin MEASUREMENT resources.CarMessages.time "" FLOAT32_IEEE esdl_ident_s 1 100.0 -3.4028234663852886E+38 3.4028234663852886E+38 ECU_ADDRESS 0x0 /end MEASUREMENT
/begin MEASUREMENT resources.DriverMessages.brake "" FLOAT32_IEEE esdl_ident 1 100.0 -3.4028234663852886E+38 3.4028234663852886E+38 ECU_ADDRESS 0x0 /end MEASUREMENT
/begin MEASUREMENT resources.DriverMessages.power "" FLOAT32_IEEE esdl_ident 1 100.0 -3.4028234663852886E+38 3.4028234663852886E+38 ECU_ADDRESS 0x0 /end MEASUREMENT
/begin MEASUREMENT resources.DriverMessages.on "" UBYTE esdl_ident 1 100.0 0 1 ECU_ADDRESS 0x0 BIT_MASK 0x1 /end MEASUREMENT
/begin MEASUREMENT resources.DriverMessages.display "" UBYTE esdl_ident 1 100.0 0 1 ECU_ADDRESS 0x0 BIT_MASK 0x1 /end MEASUREMENT
/begin MEASUREMENT resources.DriverMessages.increment "" UBYTE esdl_ident 1 100.0 0 1 ECU_ADDRESS 0x0 BIT_MASK 0x1 /end MEASUREMENT
/begin MEASUREMENT resources.DriverMessages.decrement "" UBYTE esdl_ident 1 100.0 0 1 ECU_ADDRESS 0x0 BIT_MASK 0x1 /end MEASUREMENT
/begin MEASUREMENT resources.DriverMessages.soll "" FLOAT32_IEEE esdl_ident_kmh 1 100.0 -3.4028234663852886E+38 3.4028234663852886E+38 ECU_ADDRESS 0x0 /end MEASUREMENT
/begin COMPU_METHOD esdl_ident "" RAT_FUNC "%12.4" "" COEFFS 0 1 0 0 0 1 /end COMPU_METHOD
/begin COMPU_METHOD esdl_ident_a "" RAT_FUNC "%12.4" "a" COEFFS 0 1 0 0 0 1 /end COMPU_METHOD
/begin COMPU_METHOD esdl_ident_km2fh "" RAT_FUNC "%12.4" "km/h" COEFFS 0 1 0 0 0 1 /end COMPU_METHOD
/begin COMPU_METHOD esdl_ident_kmh "" RAT_FUNC "%12.4" "kmh" COEFFS 0 1 0 0 0 1 /end COMPU_METHOD
/begin COMPU_METHOD esdl_ident_m "" RAT_FUNC "%12.4" "m" COEFFS 0 1 0 0 0 1 /end COMPU_METHOD
/begin COMPU_METHOD esdl_ident_s "" RAT_FUNC "%12.4" "s" COEFFS 0 1 0 0 0 1 /end COMPU_METHOD
/begin COMPU_METHOD esdl_myCar_CSMStatemachineStates "" TAB_VERB "%12.4" "" /* compu_tab_ref */ COMPU_TAB_REF esdl_myCar_CSMStatemachineStates_vtab /end COMPU_METHOD
/begin COMPU_VTAB esdl_myCar_CSMStatemachineStates_vtab "" TAB_VERB /* number value pairs */ 2 /* value pair */ 0 "Off" /* value pair */ 1 "On" /* default value */ DEFAULT_VALUE "Error" /end COMPU_VTAB
/begin FUNCTION myCar.myCar "" /begin DEF_CHARACTERISTIC myCar.myCar.g /end DEF_CHARACTERISTIC
 /begin IN_MEASUREMENT resources.CarMessages.brake resources.CarMessages.power resources.CarMessages.steering /end IN_MEASUREMENT
 /begin OUT_MEASUREMENT resources.CarMessages.bearing resources.CarMessages.v resources.CarMessages.x resources.CarMessages.y /end OUT_MEASUREMENT
 /begin SUB_FUNCTION myCar.myCar.myVehicle /end SUB_FUNCTION
/end FUNCTION
/begin FUNCTION myCar.myCar.myVehicle ""
 /begin DEF_CHARACTERISTIC myCar.myCar.myVehicle.BrakeMomentum myCar.myCar.myVehicle.EngineMomentum myCar.myCar.myVehicle.AirFriction myCar.myCar.myVehicle.Landscape myCar.myCar.myVehicle.TrackSize /end DEF_CHARACTERISTIC
 /begin LOC_MEASUREMENT myCar.myCar.myVehicle.bearing myCar.myCar.myVehicle.dh myCar.myCar.myVehicle.dist myCar.myCar.myVehicle.ds myCar.myCar.myVehicle.h myCar.myCar.myVehicle.momentum myCar.myCar.myVehicle.v myCar.myCar.myVehicle.x myCar.myCar.myVehicle.y /end LOC_MEASUREMENT
 /begin SUB_FUNCTION myCar.myCar.myVehicle.MyTurn_instance /end SUB_FUNCTION
/end FUNCTION
/begin FUNCTION myCar.myCar.myVehicle.MyTurn_instance "" /begin DEF_CHARACTERISTIC myCar.myCar.myVehicle.MyTurn_instance.D /end DEF_CHARACTERISTIC
 /begin LOC_MEASUREMENT myCar.myCar.myVehicle.MyTurn_instance.bearing myCar.myCar.myVehicle.MyTurn_instance.dpi myCar.myCar.myVehicle.MyTurn_instance.pi myCar.myCar.myVehicle.MyTurn_instance.x myCar.myCar.myVehicle.MyTurn_instance.y /end LOC_MEASUREMENT
/end FUNCTION
/begin FUNCTION myCar.Control ""
 /begin IN_MEASUREMENT resources.CarMessages.v resources.DriverMessages.brake resources.DriverMessages.on resources.DriverMessages.power resources.DriverMessages.soll /end IN_MEASUREMENT
 /begin OUT_MEASUREMENT resources.CarMessages.brake resources.CarMessages.power /end OUT_MEASUREMENT
 /begin SUB_FUNCTION myCar.Control.Regler_instance myCar.Control.CSM_instance /end SUB_FUNCTION
/end FUNCTION
/begin FUNCTION myCar.Control.Regler_instance ""
 /begin LOC_MEASUREMENT myCar.Control.Regler_instance.bra myCar.Control.Regler_instance.pow /end LOC_MEASUREMENT
/end FUNCTION
/begin FUNCTION myCar.Control.CSM_instance ""
 /begin LOC_MEASUREMENT myCar.Control.CSM_instance.bra myCar.Control.CSM_instance.isOn myCar.Control.CSM_instance.on myCar.Control.CSM_instance.sm /end LOC_MEASUREMENT
/end FUNCTION
/begin FUNCTION myCar.Driver ""
 /begin DEF_CHARACTERISTIC myCar.Driver.mypower myCar.Driver.mysoll myCar.Driver.myon myCar.Driver.automatic /end DEF_CHARACTERISTIC
 /begin IN_MEASUREMENT resources.CarMessages.v /end IN_MEASUREMENT
 /begin OUT_MEASUREMENT resources.CarMessages.power resources.DriverMessages.brake resources.DriverMessages.on resources.DriverMessages.power resources.DriverMessages.soll /end OUT_MEASUREMENT
 /begin SUB_FUNCTION myCar.Driver.EdgeRising_instance myCar.Driver.StopWatch_instance myCar.Driver.R /end SUB_FUNCTION
/end FUNCTION
/begin FUNCTION myCar.Driver.EdgeRising_instance "EdgeRising detects a rising edge of the logical input signal."
 /begin LOC_MEASUREMENT myCar.Driver.EdgeRising_instance.buffer myCar.Driver.EdgeRising_instance.oldSignal /end LOC_MEASUREMENT
/end FUNCTION
/begin FUNCTION myCar.Driver.StopWatch_instance "StopWatch increments the time counter by one dT." /begin LOC_MEASUREMENT myCar.Driver.StopWatch_instance.timeCounter /end LOC_MEASUREMENT /end FUNCTION
/begin FUNCTION myCar.Driver.R "EdgeRising detects a rising edge of the logical input signal." /begin LOC_MEASUREMENT myCar.Driver.R.buffer myCar.Driver.R.oldSignal /end LOC_MEASUREMENT /end FUNCTION
/begin FUNCTION myCar.KFDriver ""
 /begin DEF_CHARACTERISTIC myCar.KFDriver.power myCar.KFDriver.duration myCar.KFDriver.on myCar.KFDriver.brake myCar.KFDriver.soll /end DEF_CHARACTERISTIC
 /begin OUT_MEASUREMENT resources.DriverMessages.brake resources.DriverMessages.on resources.DriverMessages.power resources.DriverMessages.soll /end OUT_MEASUREMENT
 /begin SUB_FUNCTION myCar.KFDriver.SW /end SUB_FUNCTION
/end FUNCTION
/begin FUNCTION myCar.KFDriver.SW "StopWatch increments the time counter by one dT." /begin LOC_MEASUREMENT myCar.KFDriver.SW.timeCounter /end LOC_MEASUREMENT /end FUNCTION
/begin RECORD_LAYOUT STANDARD_CURVE_R32R32 /* axis size */ NO_AXIS_PTS_X 1 UWORD /* axis */ AXIS_PTS_X 2 FLOAT32_IEEE INDEX_INCR DIRECT FNC_VALUES 3 FLOAT32_IEEE COLUMN_DIR DIRECT /end RECORD_LAYOUT
/begin RECORD_LAYOUT STANDARD_MAP_R32R32R32 /* x axis size */ NO_AXIS_PTS_X 1 UWORD /* y axis size */ NO_AXIS_PTS_Y 2 UWORD /* x axis */ AXIS_PTS_X 3 FLOAT32_IEEE INDEX_INCR DIRECT /* y axis */ AXIS_PTS_Y 4 FLOAT32_IEEE INDEX_INCR DIRECT FNC_VALUES 5 FLOAT32_IEEE COLUMN_DIR DIRECT /end RECORD_LAYOUT
/begin RECORD_LAYOUT STANDARD_VALUE_R32 FNC_VALUES 1 FLOAT32_IEEE COLUMN_DIR DIRECT /end RECORD_LAYOUT
/begin RECORD_LAYOUT STANDARD_VALUE_U8 FNC_VALUES 1 UBYTE COLUMN_DIR DIRECT /end RECORD_LAYOUT
/begin GROUP myCar.Control "" ROOT /begin SUB_GROUP myCar.Control.Regler_instance myCar.Control.CSM_instance /end SUB_GROUP /end GROUP
/begin GROUP myCar.Control.CSM_instance ""
 /begin REF_MEASUREMENT myCar.Control.CSM_instance.bra myCar.Control.CSM_instance.isOn myCar.Control.CSM_instance.on myCar.Control.CSM_instance.sm /end REF_MEASUREMENT
/end GROUP
/begin GROUP myCar.Control.Regler_instance ""
 /begin REF_MEASUREMENT myCar.Control.Regler_instance.bra myCar.Control.Regler_instance.pow /end REF_MEASUREMENT
/end GROUP
/begin GROUP myCar.Driver "" ROOT
 /begin REF_CHARACTERISTIC myCar.Driver.mypower myCar.Driver.mysoll myCar.Driver.myon myCar.Driver.automatic /end REF_CHARACTERISTIC
 /begin SUB_GROUP myCar.Driver.EdgeRising_instance myCar.Driver.StopWatch_instance myCar.Driver.R /end SUB_GROUP
/end GROUP
/begin GROUP myCar.Driver.EdgeRising_instance "EdgeRising detects a rising edge of the logical input signal."
 /begin REF_MEASUREMENT myCar.Driver.EdgeRising_instance.buffer myCar.Driver.EdgeRising_instance.oldSignal /end REF_MEASUREMENT
/end GROUP
/begin GROUP myCar.Driver.R "EdgeRising detects a rising edge of the logical input signal." /begin REF_MEASUREMENT myCar.Driver.R.buffer myCar.Driver.R.oldSignal /end REF_MEASUREMENT /end GROUP
/begin GROUP myCar.Driver.StopWatch_instance "StopWatch increments the time counter by one dT." /begin REF_MEASUREMENT myCar.Driver.StopWatch_instance.timeCounter /end REF_MEASUREMENT /end GROUP
/begin GROUP myCar.KFDriver "" ROOT
 /begin REF_CHARACTERISTIC myCar.KFDriver.power myCar.KFDriver.duration myCar.KFDriver.on myCar.KFDriver.brake myCar.KFDriver.soll /end REF_CHARACTERISTIC
 /begin SUB_GROUP myCar.KFDriver.SW /end SUB_GROUP
/end GROUP
/begin GROUP myCar.KFDriver.SW "StopWatch increments the time counter by one dT." /begin REF_MEASUREMENT myCar.KFDriver.SW.timeCounter /end REF_MEASUREMENT /end GROUP
/begin GROUP myCar.myCar "" ROOT /begin REF_CHARACTERISTIC myCar.myCar.g /end REF_CHARACTERISTIC /begin SUB_GROUP myCar.myCar.myVehicle /end SUB_GROUP /end GROUP
/begin GROUP myCar.myCar.myVehicle ""
 /begin REF_CHARACTERISTIC myCar.myCar.myVehicle.BrakeMomentum myCar.myCar.myVehicle.EngineMomentum myCar.myCar.myVehicle.AirFriction myCar.myCar.myVehicle.Landscape myCar.myCar.myVehicle.TrackSize /end REF_CHARACTERISTIC
 /begin REF_MEASUREMENT myCar.myCar.myVehicle.bearing myCar.myCar.myVehicle.dh myCar.myCar.myVehicle.dist myCar.myCar.myVehicle.ds myCar.myCar.myVehicle.h myCar.myCar.myVehicle.momentum myCar.myCar.myVehicle.v myCar.myCar.myVehicle.x myCar.myCar.myVehicle.y /end REF_MEASUREMENT
 /begin SUB_GROUP myCar.myCar.myVehicle.MyTurn_instance /end SUB_GROUP
/end GROUP
/begin GROUP myCar.myCar.myVehicle.MyTurn_instance "" /begin REF_CHARACTERISTIC myCar.myCar.myVehicle.MyTurn_instance.D /end REF_CHARACTERISTIC
 /begin REF_MEASUREMENT myCar.myCar.myVehicle.MyTurn_instance.bearing myCar.myCar.myVehicle.MyTurn_instance.dpi myCar.myCar.myVehicle.MyTurn_instance.pi myCar.myCar.myVehicle.MyTurn_instance.x myCar.myCar.myVehicle.MyTurn_instance.y /end REF_MEASUREMENT
/end GROUP
/begin GROUP resources.CarMessages "" ROOT
 /begin REF_MEASUREMENT resources.CarMessages.bearing resources.CarMessages.brake resources.CarMessages.power resources.CarMessages.steering resources.CarMessages.time resources.CarMessages.v resources.CarMessages.x resources.CarMessages.y /end REF_MEASUREMENT
/end GROUP
/begin GROUP resources.DriverMessages "" ROOT
 /begin REF_MEASUREMENT resources.DriverMessages.brake resources.DriverMessages.decrement resources.DriverMessages.display resources.DriverMessages.increment resources.DriverMessages.on resources.DriverMessages.power resources.DriverMessages.soll /end REF_MEASUREMENT
/end GROUP
/end MODULE
/end PROJECT
